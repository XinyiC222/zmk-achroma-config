#include "achroma.dtsi"

/ {
    chosen {
        zmk,physical-layout = &physical_layout_split;
    };

    kscan0: kscan0 {
        compatible = "zmk,kscan-gpio-matrix";
        diode-direction = "col2row";
        wakeup-source;

        // ASSUMES the right half is the same PCB flipped with the nice!nano mounted mirrored.
        // Each PCB hole then receives the pin from the opposite side of the controller (same row).
        // col0..col4 -> pads 5, 6, 7, 8, 9 -> P0.17, P0.20, P0.22, P0.24, P1.00
        col-gpios
            = <&gpio0 17 GPIO_ACTIVE_HIGH>
            , <&gpio0 20 GPIO_ACTIVE_HIGH>
            , <&gpio0 22 GPIO_ACTIVE_HIGH>
            , <&gpio0 24 GPIO_ACTIVE_HIGH>
            , <&gpio1 0  GPIO_ACTIVE_HIGH>
            ;

        // row0..row3 -> pads 17, 19, 23, 24 -> P0.31, P0.02, P0.10, P0.09
        row-gpios
            = <&gpio0 31 (GPIO_ACTIVE_HIGH | GPIO_PULL_DOWN)>
            , <&gpio0 2  (GPIO_ACTIVE_HIGH | GPIO_PULL_DOWN)>
            , <&gpio0 10 (GPIO_ACTIVE_HIGH | GPIO_PULL_DOWN)>
            , <&gpio0 9  (GPIO_ACTIVE_HIGH | GPIO_PULL_DOWN)>
            ;
    };
};

&default_transform {
    col-offset = <5>;
};

// --- RIGHT-SIDE SPI3 DATA PIN OVERRIDE ---
// Replace '0, 11' below with the exact right-side GPIO wired to LED DIN
&spi3_default {
    group1 {
        psels = <NRF_PSEL(SPIM_MOSI, 0, 6)>;
    };
};

&spi3_sleep {
    group1 {
        psels = <NRF_PSEL(SPIM_MOSI, 0, 6)>;
        low-power-enable;
    };
};

};
